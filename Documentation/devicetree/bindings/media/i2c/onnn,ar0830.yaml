## Documentation/devicetree/bindings/media/i2c/onnn,ar0830.yaml
```yaml
# SPDX-License-Identifier: (GPL-2.0-only OR BSD-2-Clause)
%YAML 1.2
---
$id: http://devicetree.org/schemas/media/i2c/onnn,ar0830.yaml#
$schema: http://devicetree.org/meta-schemas/core.yaml#

title: OnSemi AR0830 1/2.9-inch 8MP CMOS Digital Image Sensor

maintainers:
  - Stefan Riedmueller <s.riedmueller@phytec.de>

description: |
  The onsemi AR0830 is a stacked 1/2.9-inch back side illuminated
  (BSI) CMOS active-pixel digital image sensor with a pixel array of
  3840Hx2160V (3856H x 2176V including border pixels). It features a 1, 2 or
  4 lane MIPI-CSI2 interface. It is programmable through a simple two-wire
  serial interface.

allOf:
  - $ref: /schemas/media/video-interface-devices.yaml#

properties:
  compatible:
    enum:
      - onnn,ar0830

  reg:
    description: I2C device address
    maxItems: 1

  clocks:
    maxItems: 1

  clock-names:
    const: ext

  reset-gpios:
    maxItems: 1
    description: Chip reset GPIO

  port:
    $ref: /schemas/graph.yaml#/$defs/port-base
    additionalProperties: false

    properties:
      endpoint:
        $ref: /schemas/media/video-interfaces.yaml#
        unevaluatedProperties: false

        properties:
          bus-type:
            const: 4 # MIPI CSI-2 D-PHY

          link-frequencies:
            maximum: 750000000

          data-lanes:
            oneOf:
              - items:
                - const: 1
              - items:
                - const: 1
                - const: 2
              - items:
                - const: 1
                - const: 2
                - const: 3
                - const: 4

          clock-lanes: true
          clock-noncontinuous: true

        required:
          - data-lanes
          - link-frequencies

required:
  - compatible
  - reg
  - clocks
  - clock-names
  - port

additionalProperties: false

examples:
  - |
    i2c0 {
        #address-cells = <1>;
        #size-cells = <0>;

        camera@36 {
            compatible = "onnn,ar0830";
            reg = <0x36>;
            reset-gpios = <&gpio_sensor 0 0>;

            clocks = <&sensor_clk>;
            clock-names = "ext";

            port {
                camera_1: endpoint {
                    bus-type = <4>; /* MIPI CSI-2 D-PHY */
                    link-frequencies = /bits/ 64 <288000000 500000000 750000000>;
                    data-lanes = <1 2 3 4>;
                    clock-lanes = <0>;
                    clock-noncontinuous = <1>;
                };
            };
        };
    };
...
```
