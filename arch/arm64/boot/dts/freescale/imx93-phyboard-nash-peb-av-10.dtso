// SPDX-License-Identifier: (GPL-2.0+ OR MIT)
/*
 * Copyright (C) 2025 PHYTEC Messtechnik GmbH
 * Author: Primoz Fiser <primoz.fiser@norik.com>
 */

/dts-v1/;
/plugin/;

#include "imx93-phyboard-nash-peb-av-10.dtsi"
