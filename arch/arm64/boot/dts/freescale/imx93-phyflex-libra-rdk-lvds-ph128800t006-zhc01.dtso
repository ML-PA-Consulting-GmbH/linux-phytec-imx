// SPDX-License-Identifier: (GPL-2.0-or-later OR MIT)
/*
 * Copyright (C) 2026 PHYTEC Messtechnik GmbH
 */

#include "imx93-phyflex-libra-rdk-lvds.dtsi"

&panel_lvds1 {
	compatible = "powertip,ph128800t006-zhc01";
	status = "okay";
};
