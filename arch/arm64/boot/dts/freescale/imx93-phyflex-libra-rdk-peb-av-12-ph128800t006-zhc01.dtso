// SPDX-License-Identifier: (GPL-2.0-or-later OR MIT)
/*
 * Copyright (C) 2026 PHYTEC Messtechnik GmbH
 * Author: Florijan Plohl <florijan.plohl@norik.com>
 */

#include "imx93-phyflex-libra-rdk-peb-av-12.dtsi"

&panel_peb {
	compatible = "powertip,ph128800t006-zhc01";
	status = "okay";
};
